/dts-v1/;
/plugin/;

/ {
    compatible = "rockchip,rk3528";

	fragment@0 {
		target = <&gmac0>;
		__overlay__ {
			status = "disabled";
		};
	};

	fragment@1 {
		target = <&gmac1>;
		__overlay__ {
			status = "okay";
		};
    };
};
